## main/Kconfig.projbuild
```kconfig
menu "WiFI Configuration"

    config WIFI_SSID
        string "WiFi SSID"
        default "YourWiFiSSID"
        help
            SSID (network name) for the ESP32 to connect to.

    config WIFI_PASSWORD
        string "WiFi Password"
        default "YourWiFiPassword"
        help
            WiFi password (WPA or WPA2) for the ESP32 to use.
endmenu

menu "Audio Streaming Configuration"
    menu "Networking Configuration"
        config MULTICAST_IP
            string "Multicast IP Address"
            default "224.1.1.1"
            help
                Multicast group IP address to join.

        config UDP_PORT
            int "UDP Port"
            default 5005
            help
                UDP port number to listen on.
        
        config RTP_HEADER_SIZE
            int "RTP Header Size"
            default 12
            help
                Size of the RTP header in bytes.
        
        config UDP_RECV_BUFFER_SIZE
            int "UDP Receive Buffer Size"
            default 2048
            help
                Size of the UDP receive buffer in bytes.
    endmenu

    menu "Audio Configuration"
        config AUDIO_SAMPLE_RATE
            int "Audio Sample Rate"
            default 48000
            help
                Sample rate for audio playback (8000, 16000, 24000, 48000).

        config BITS_PER_SAMPLE
            int "Bits per sample"
            default 16
            help
                8,16,32...

        config AUDIO_CHANNELS
            int "Audio Channels"
            default 2
            range 1 2
            help
                Number of audio channels (1=Mono, 2=Stereo).
        config AUDIO_BUFFER_SIZE
            int "Audio Buffer Size"
            default 16384
            help
                Size of the audio buffer in bytes.
    endmenu

    menu "Opus Configuration"
        config OPUS_FRAME_SIZE
            int "Frame Size"
            default 960
            help
                Number of samples per channel in each Opus frame (e.g., 960 for 20ms at 48kHz).
        config DECODED_PCM_BUFFER_SIZE
            int "Decoded PCM Buffer Size"
            default 4096
            help
                Size of the buffer for decoded PCM samples in bytes.
    endmenu
endmenu
```

## sdkconfig.defaults
```kconfig
# ESP32-LyraT default configuration

# Audio board selection
CONFIG_ESP_LYRAT_V4_3_BOARD=y

# FreeRTOS configuration
CONFIG_FREERTOS_HZ=1000
CONFIG_FREERTOS_UNICORE=n

# ESP32-specific
CONFIG_IDF_CMAKE=y
CONFIG_IDF_TARGET_ARCH_XTENSA=y
CONFIG_IDF_TARGET="esp32"
CONFIG_IDF_TARGET_ESP32=y
CONFIG_IDF_FIRMWARE_CHIP_ID=0x0000

CONFIG_ESP32_DEFAULT_CPU_FREQ_240=y
CONFIG_ESP32_DEFAULT_CPU_FREQ_MHZ=240

# Common ESP-related
CONFIG_ESP_ALLOW_BSS_SEG_EXTERNAL_MEMORY=y

# SPI RAM config
CONFIG_SPIRAM_ALLOW_BSS_SEG_EXTERNAL_MEMORY=y
CONFIG_SPIRAM_ALLOW_STACK_EXTERNAL_MEMORY=y

# ESP System Settings
CONFIG_ESP_MAIN_TASK_STACK_SIZE=4096

# IPC (Inter-Processor Call)
CONFIG_ESP_IPC_TASK_STACK_SIZE=2048

# Memory configuration
CONFIG_SPIRAM_SUPPORT=y
CONFIG_SPIRAM_BOOT_INIT=y
CONFIG_SPIRAM_USE_MALLOC=y
CONFIG_SPIRAM_TYPE_AUTO=y
CONFIG_SPIRAM_SIZE=-1

# WiFi configuration
CONFIG_ESP32_WIFI_STATIC_RX_BUFFER_NUM=10
CONFIG_ESP32_WIFI_DYNAMIC_RX_BUFFER_NUM=32
CONFIG_ESP32_WIFI_DYNAMIC_TX_BUFFER_NUM=32
CONFIG_ESP32_WIFI_AMPDU_TX_ENABLED=y
CONFIG_ESP32_WIFI_AMPDU_RX_ENABLED=y

# LWIP configuration for multicast
CONFIG_LWIP_MAX_SOCKETS=1
CONFIG_LWIP_SO_REUSE=y
CONFIG_LWIP_SO_RCVBUF=y
CONFIG_LWIP_RECV_BUFSIZE_DEFAULT=8192

CONFIG_LWIP_TCPIP_RECVMBOX_SIZE=16
CONFIG_LWIP_TCP_RECVMBOX_SIZE=16
CONFIG_LWIP_TCP_ACCEPTMBOX_SIZE=16
CONFIG_LWIP_MAX_UDP_PCBS=1
CONFIG_LWIP_UDP_RECVMBOX_SIZE=16
CONFIG_LWIP_TCPIP_TASK_STACK_SIZE=4096

# SPI Flash driver
CONFIG_SPI_FLASH_WRITE_CHUNK_SIZE=4096

# Component config
CONFIG_AUDIO_BOARD_CUSTOM=n

# Log levels
CONFIG_LOG_DEFAULT_LEVEL_INFO=y
CONFIG_LOG_MAXIMUM_LEVEL_VERBOSE=y

# Task watchdog
CONFIG_ESP_TASK_WDT=y
CONFIG_ESP_TASK_WDT_TIMEOUT_S=10

CONFIG_PARTITION_TABLE_CUSTOM=y
CONFIG_PARTITION_TABLE_CUSTOM_FILENAME="partitions.csv"
CONFIG_ESPTOOLPY_FLASHSIZE_8MB=y
CONFIG_FREERTOS_ENABLE_BACKWARD_COMPATIBILITY=y

#
# Audio Streaming Configuration
#
## Networking Configuration
CONFIG_MULTICAST_IP="224.1.1.1"
CONFIG_UDP_PORT=5005
CONFIG_RTP_HEADER_SIZE=12
CONFIG_UDP_RECV_BUFFER_SIZE=2048
## Audio Configuration
CONFIG_AUDIO_SAMPLE_RATE=48000
CONFIG_BITS_PER_SAMPLE=16
CONFIG_AUDIO_CHANNELS=2
CONFIG_AUDIO_BUFFER_SIZE=16384
## Opus Configuration
CONFIG_OPUS_FRAME_SIZE=960
CONFIG_DECODED_PCM_BUFFER_SIZE=4096
```
